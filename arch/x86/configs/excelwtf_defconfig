## arch/x86/configs/excelwtf_defconfig
```kconfig
CONFIG_PREEMPT=y
CONFIG_HZ_1000=y
CONFIG_NO_HZ_FULL=y
CONFIG_BFQ_GROUP_IOSCHED=y
CONFIG_DRM_AMD_DC=y
CONFIG_DRM_NVIDIA=y
CONFIG_SND_HDA_INTEL=y
CONFIG_USB_HID=y
CONFIG_HIDRAW=y
CONFIG_X86_64=y
CONFIG_SMP=y
CONFIG_KVM_GUEST=y
CONFIG_VIRTIO=y

Gaming-optimized config; expand with make menuconfig
```
